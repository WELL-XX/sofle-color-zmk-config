## Kconfig
```kconfig
config SOFLE_COLOR_G2_PROBE
    bool "Sofle Color G2 hardware interface compile probe"
    default y if SHIELD_SOFLE_COLOR_LEFT || SHIELD_SOFLE_COLOR_RIGHT
    select SPI
    select PWM
    help
      Validate the dedicated SPI2 descriptor and independent active-low
      open-drain gate definitions and PWM0 output resource. Keep LCD/RGB off;
      do not transmit pixels or LED data.
```

## boards/shields/sofle_color/Kconfig.defconfig
```kconfig
if SHIELD_SOFLE_COLOR_LEFT || SHIELD_SOFLE_COLOR_RIGHT

config ZMK_KEYBOARD_NAME
    default "Sofle Color"

config ZMK_SPLIT
    default y

endif

if SHIELD_SOFLE_COLOR_LEFT

config ZMK_SPLIT_ROLE_CENTRAL
    default y

endif
```

## boards/shields/sofle_color/Kconfig.shield
```kconfig
config SHIELD_SOFLE_COLOR_LEFT
    def_bool $(shields_list_contains,sofle_color_left)

config SHIELD_SOFLE_COLOR_RIGHT
    def_bool $(shields_list_contains,sofle_color_right)
```

## config/west.yml
```yaml
manifest:
  remotes:
    - name: zmkfirmware
      url-base: https://github.com/zmkfirmware
  projects:
    - name: zephyr
      remote: zmkfirmware
      revision: 10ba6d0cb38bc3d258775d27982f707599320085
      import:
        name-blocklist:
          - ci-tools
          - hal_altera
          - hal_cypress
          - hal_infineon
          - hal_microchip
          - hal_nxp
          - hal_openisa
          - hal_xtensa
          - hal_st
          - hal_ti
          - loramac-node
          - mcuboot
          - mcumgr
          - net-tools
          - openthread
          - edtt
          - trusted-firmware-m
    - name: zmk
      remote: zmkfirmware
      revision: 4dd95d7840eb3d5a3f59bb29fbf1ab054715ef85
      import: app/west.yml
  self:
    path: config
```

## dts/bindings/sofle,dh06-probe.yaml
```yaml
description: DH06 SPI interface declaration for G2 compilation, not a display driver
compatible: "sofle,dh06-probe"
include: spi-device.yaml
```

## dts/bindings/sofle,power-domains.yaml
```yaml
description: Independent Sofle Color LCD/RGB gates and native parent rail
compatible: "sofle,power-domains"
properties:
  parent-gpios:
    type: phandle-array
    required: true
  lcd-gate-gpios:
    type: phandle-array
    required: true
  rgb-gate-gpios:
    type: phandle-array
    required: true
  rgb-data-gpios:
    type: phandle-array
    required: true
  lcd-sck-gpios:
    type: phandle-array
    required: true
  lcd-mosi-gpios:
    type: phandle-array
    required: true
  lcd-cs-gpios:
    type: phandle-array
    required: true
```

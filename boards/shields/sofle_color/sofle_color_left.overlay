#include "sofle_color.dtsi"

&kscan0 {
    col-gpios = <&pro_micro 19 GPIO_ACTIVE_HIGH>,
                <&pro_micro 18 GPIO_ACTIVE_HIGH>,
                <&pro_micro 15 GPIO_ACTIVE_HIGH>,
                <&pro_micro 14 GPIO_ACTIVE_HIGH>,
                <&pro_micro 16 GPIO_ACTIVE_HIGH>,
                <&pro_micro 10 GPIO_ACTIVE_HIGH>,
                <&pro_micro 20 GPIO_ACTIVE_HIGH>;
};

&sc_domains {
    rgb-gate-gpios = <&gpio0 31 (GPIO_ACTIVE_LOW | GPIO_OPEN_DRAIN)>;
};
